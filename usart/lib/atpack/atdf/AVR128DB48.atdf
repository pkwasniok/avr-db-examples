# AVR128DB48 device description
Architecture: AVR8X; Family: AVR
Programming and debug interfaces: UPDI
Registers are 8-bit, read-write, reset 0x0 unless marked. A register's access mark holds for its fields unless they carry their own. Offsets are from the block's base; lines under a group give offsets from that group; [hi:lo] are bit positions; {n}, {i} and the like mark numbered series; 'fields as' and 'values as' point back to an identical list; <NAME> marks a mode.

## Ordering variants
AVR128DB48: QFN48, up to 32 MHz, -40 to 125 C, 1.8 to 5.5 V

## Memory
data space: start 0x0000 size 0x10000, little endian
  0x00 IO size 0x103F io, rw
  0x1040 LOCKBITS size 0x04 lockbits, rw, page 0x1
  0x1050 FUSES size 0x10 fuses, rw, page 0x1
  0x1080 USER_SIGNATURES size 0x20 user_signatures, rw, page 0x20
  0x1100 SIGNATURES size 0x03 signatures, ro, page 0x80
  0x1103 PROD_SIGNATURES size 0x7D signatures, ro, page 0x80
  0x1400 EEPROM size 0x200 eeprom, rw, page 0x1
  0x4000 INTERNAL_SRAM size 0x4000 ram, rw
  0x8000 MAPPED_PROGMEM size 0x8000 other, rw, page 0x200
prog space: start 0x0000 size 0x20000, little endian
  0x00 PROGMEM size 0x20000 flash, rw, executable, page 0x200

## Peripheral instances (address, pins/pin function, parameters)
AC0 at 0x0680 (AC)
  pins: N0 PD3; N1 PD0; N2 PD7; P0 PD2; P1 PE0; P2 PE2; P3 PD6; OUT0 PA7 or PC6/AC0_ALT1
  pin routing set by: PORTMUX.ACROUTEA.AC0
AC1 at 0x0688 (AC)
  pins: N0 PD5; N1 PD0; N2 PD7; P0 PD2; P1 PD3; P2 PD4; P3 PD6; OUT0 PA7 or PC6/AC1_ALT1
  pin routing set by: PORTMUX.ACROUTEA.AC1
AC2 at 0x0690 (AC)
  pins: N0 PD7; N1 PD0; N2 PD7; P0 PD2; P1 PD4; P2 PE1; P3 PD6; OUT0 PA7 or PC6/AC2_ALT1
  pin routing set by: PORTMUX.ACROUTEA.AC2
ADC0 at 0x0600 (ADC)
  pins: AIN{n} PD{n}/AIN0 (n=0..7); AIN8 PE0/AIN0; AIN9 PE1/AIN0; AIN10 PE2/AIN0; AIN11 PE3/AIN0; AIN16 PF0/AIN0; AIN17 PF1/AIN0; AIN18 PF2/AIN0; AIN19 PF3/AIN0; AIN20 PF4/AIN0; AIN21 PF5/AIN0
BOD at 0x00A0
CCL at 0x01C0
  pins: LUT0_IN0 PA0/CCL_IN; LUT0_IN1 PA1/CCL_IN; LUT0_IN2 PA2/CCL_IN; LUT1_IN0 PC0/CCL_IN; LUT1_IN1 PC1/CCL_IN; LUT1_IN2 PC2/CCL_IN; LUT2_IN0 PD0/CCL_IN; LUT2_IN1 PD1/CCL_IN; LUT2_IN2 PD2/CCL_IN; LUT3_IN0 PF0/CCL_IN; LUT3_IN1 PF1/CCL_IN; LUT3_IN2 PF2/CCL_IN; LUT4_IN0 PB0/CCL_IN; LUT4_IN1 PB1/CCL_IN; LUT4_IN2 PB2/CCL_IN; LUT0_OUT0 PA3 or PA6/CCL_ALT1; LUT1_OUT0 PC3 or PC6/CCL_ALT1; LUT2_OUT0 PD3 or PD6/CCL_ALT1; LUT3_OUT0 PF3; LUT4_OUT0 PB3
  pin routing set by: PORTMUX.CCLROUTEA.LUT0, PORTMUX.CCLROUTEA.LUT1, PORTMUX.CCLROUTEA.LUT2, PORTMUX.CCLROUTEA.LUT3, PORTMUX.CCLROUTEA.LUT4
CLKCTRL at 0x0060
  pins: CLKOUT PA7; EXTCLK PA0; XTAL32K1 PF0; XTAL32K2 PF1; XTALHF1 PA0; XTALHF2 PA1
CPU at 0x0030
  parameters: CORE_VERSION=V4S
CPUINT at 0x0110
CRCSCAN at 0x0120
DAC0 at 0x06A0 (DAC)
  pins: OUT0 PD6
EVSYS at 0x0200
  pins: EVOUT0 PA2 or PA7/EVSYS_ALT1; EVOUT1 PB2; EVOUT2 PC2 or PC7/EVSYS_ALT1; EVOUT3 PD2 or PD7/EVSYS_ALT1; EVOUT4 PE2; EVOUT5 PF2
  pin routing set by: PORTMUX.EVSYSROUTEA.EVOUTA, PORTMUX.EVSYSROUTEA.EVOUTB, PORTMUX.EVSYSROUTEA.EVOUTC, PORTMUX.EVSYSROUTEA.EVOUTD, PORTMUX.EVSYSROUTEA.EVOUTE, PORTMUX.EVSYSROUTEA.EVOUTF
FUSE at 0x1050
GPR at 0x001C
LOCK at 0x1040
MVIO at 0x00C0
NVMCTRL at 0x1000
OPAMP at 0x0700
  pins: OP0INN PD3; OP0INP PD1; OP0OUT PD2; OP1INN PD7; OP1INP PD4; OP1OUT PD5; OP2INN PE3; OP2INP PE1; OP2OUT PE2
PORTA at 0x0400 (PORT)
  pins: PIN{n} PA{n}/IOPORT (n=0..7)
PORTB at 0x0420 (PORT)
  pins: PIN0 PB0/IOPORT; PIN1 PB1/IOPORT; PIN2 PB2/IOPORT; PIN3 PB3/IOPORT; PIN4 PB4/IOPORT; PIN5 PB5/IOPORT
PORTC at 0x0440 (PORT)
  pins: PIN{n} PC{n}/IOPORT (n=0..7)
PORTD at 0x0460 (PORT)
  pins: PIN{n} PD{n}/IOPORT (n=0..7)
PORTE at 0x0480 (PORT)
  pins: PIN0 PE0/IOPORT; PIN1 PE1/IOPORT; PIN2 PE2/IOPORT; PIN3 PE3/IOPORT
PORTF at 0x04A0 (PORT)
  pins: PIN0 PF0/IOPORT; PIN1 PF1/IOPORT; PIN2 PF2/IOPORT; PIN3 PF3/IOPORT; PIN4 PF4/IOPORT; PIN5 PF5/IOPORT; PIN6 PF6/IOPORT
PORTMUX at 0x05E0
RSTCTRL at 0x0040
  pins: RESET PF6/OTHER
RTC at 0x0140
SIGROW at 0x1100
SLPCTRL at 0x0050
SPI0 at 0x0940 (SPI)
  pins: MISO PA5 or PE1/SPI0_ALT1; MOSI PA4 or PE0/SPI0_ALT1; SCK PA6 or PE2/SPI0_ALT1; SS PA7 or PE3/SPI0_ALT1
  pin routing set by: PORTMUX.SPIROUTEA.SPI0
SPI1 at 0x0960 (SPI)
  pins: MISO PC1 or PB5/SPI1_ALT1 or PC5/SPI1_ALT2; MOSI PC0 or PB4/SPI1_ALT1 or PC4/SPI1_ALT2; SCK PC2 or PC6/SPI1_ALT2; SS PC3 or PC7/SPI1_ALT2
  pin routing set by: PORTMUX.SPIROUTEA.SPI1
SYSCFG at 0x0F00
TCA0 at 0x0A00 (TCA)
  pins: WO0 PA0 or PB0/TCA0_ALT1 or PC0/TCA0_ALT2 or PD0/TCA0_ALT3 or PE0/TCA0_ALT4 or PF0/TCA0_ALT5; WO1 PA1 or PB1/TCA0_ALT1 or PC1/TCA0_ALT2 or PD1/TCA0_ALT3 or PE1/TCA0_ALT4 or PF1/TCA0_ALT5; WO2 PA2 or PB2/TCA0_ALT1 or PC2/TCA0_ALT2 or PD2/TCA0_ALT3 or PE2/TCA0_ALT4 or PF2/TCA0_ALT5; WO3 PA3 or PB3/TCA0_ALT1 or PC3/TCA0_ALT2 or PD3/TCA0_ALT3 or PE3/TCA0_ALT4 or PF3/TCA0_ALT5; WO4 PA4 or PB4/TCA0_ALT1 or PC4/TCA0_ALT2 or PD4/TCA0_ALT3 or PF4/TCA0_ALT5; WO5 PA5 or PB5/TCA0_ALT1 or PC5/TCA0_ALT2 or PD5/TCA0_ALT3 or PF5/TCA0_ALT5
  pin routing set by: PORTMUX.TCAROUTEA.TCA0
TCA1 at 0x0A40 (TCA)
  pins: WO0 PB0 or PC4/TCA1_ALT1; WO1 PB1 or PC5/TCA1_ALT1; WO2 PB2 or PC6/TCA1_ALT1; WO3 PB3; WO4 PB4; WO5 PB5
  pin routing set by: PORTMUX.TCAROUTEA.TCA1
TCB0 at 0x0B00 (TCB)
  pins: WO0 PA2 or PF4/TCB0_ALT1
  pin routing set by: PORTMUX.TCBROUTEA.TCB0
TCB1 at 0x0B10 (TCB)
  pins: WO0 PA3 or PF5/TCB1_ALT1
  pin routing set by: PORTMUX.TCBROUTEA.TCB1
TCB2 at 0x0B20 (TCB)
  pins: WO0 PC0 or PB4/TCB2_ALT1
  pin routing set by: PORTMUX.TCBROUTEA.TCB2
TCB3 at 0x0B30 (TCB)
  pins: WO0 PB5 or PC1/TCB3_ALT1
  pin routing set by: PORTMUX.TCBROUTEA.TCB3
TCD0 at 0x0B80 (TCD)
  pins: WOA PA4 or PB4/TCD0_ALT1 or PF0/TCD0_ALT2; WOB1 PA5 or PB5/TCD0_ALT1 or PF1/TCD0_ALT2; WOC2 PA6 or PF2/TCD0_ALT2; WOD3 PA7 or PF3/TCD0_ALT2
  pin routing set by: PORTMUX.TCDROUTEA.TCD0
TWI0 at 0x0900 (TWI)
  pins: SCL PA3/I2C0 or PA3/I2C0_ALT1 or PC3/I2C0_ALT2; SCL_DUAL PC3/I2C0 or PC7/I2C0_ALT or PC7/I2C0_ALT2; SDA PA2/I2C0 or PA2/I2C0_ALT1 or PC2/I2C0_ALT2; SDA_DUAL PC2/I2C0 or PC6/I2C0_ALT1 or PC6/I2C0_ALT2
  pin routing set by: PORTMUX.TWIROUTEA.TWI0
TWI1 at 0x0920 (TWI)
  pins: SCL PF3/I2C1 or PF3/I2C1_ALT1 or PB3/I2C1_ALT2; SCL_DUAL PB3/I2C1; SDA PF2/I2C1 or PF2/I2C1_ALT1 or PB2/I2C1_ALT2; SDA_DUAL PB2/I2C1
  pin routing set by: PORTMUX.TWIROUTEA.TWI1
USART0 at 0x0800 (USART)
  pins: RXD PA1 or PA5/USART0_ALT1; TXD PA0 or PA4/USART0_ALT1; XCK PA2 or PA6/USART0_ALT1; XDIR PA3 or PA7/USART0_ALT1
  pin routing set by: PORTMUX.USARTROUTEA.USART0
USART1 at 0x0820 (USART)
  pins: RXD PC1 or PC5/USART1_ALT1; TXD PC0 or PC4/USART1_ALT1; XCK PC2 or PC6/USART1_ALT1; XDIR PC3 or PC7/USART1_ALT1
  pin routing set by: PORTMUX.USARTROUTEA.USART1
USART2 at 0x0840 (USART)
  pins: RXD PF1 or PF5/USART2_ALT1; TXD PF0 or PF4/USART2_ALT1; XCK PF2; XDIR PF3
  pin routing set by: PORTMUX.USARTROUTEA.USART2
USART3 at 0x0860 (USART)
  pins: RXD PB1 or PB5/USART3_ALT1; TXD PB0 or PB4/USART3_ALT1; XCK PB2; XDIR PB3
  pin routing set by: PORTMUX.USARTROUTEA.USART3
USART4 at 0x0880 (USART)
  pins: RXD PE1; TXD PE0; XCK PE2; XDIR PE3
  pin routing set by: PORTMUX.USARTROUTEB.USART4
USERROW at 0x1080
VPORTA at 0x0000 (VPORT)
VPORTB at 0x0004 (VPORT)
VPORTC at 0x0008 (VPORT)
VPORTD at 0x000C (VPORT)
VPORTE at 0x0010 (VPORT)
VPORTF at 0x0014 (VPORT)
VREF at 0x00B0
WDT at 0x0100
ZCD0 at 0x06C0 (ZCD)
  pins: IN PD1; OUT PA7 or PC7/ZCD0_ALT1
  pin routing set by: PORTMUX.ZCDROUTEA.ZCD0
ZCD1 at 0x06C8 (ZCD)
  pins: IN PE3; OUT PA7 or PC7/ZCD1_ALT1
  pin routing set by: PORTMUX.ZCDROUTEA.ZCD1
ZCD2 at 0x06D0 (ZCD)
  pins: OUT PA7 or PC7/ZCD2_ALT1
  pin routing set by: PORTMUX.ZCDROUTEA.ZCD2

## Interrupts
1 NMI (CRCSCAN)
2 VLM (BOD)
3 CFD (CLKCTRL)
4 MVIO
5 CNT (RTC)
6 PIT (RTC)
7 CCL
8 PORT (PORTA)
9 LUNF (TCA0)
9 OVF (TCA0)
10 HUNF (TCA0)
11 CMP0 (TCA0)
11 LCMP0 (TCA0)
12 CMP1 (TCA0)
12 LCMP1 (TCA0)
13 CMP2 (TCA0)
13 LCMP2 (TCA0)
14 INT (TCB0)
15 INT (TCB1)
16 OVF (TCD0)
17 TRIG (TCD0)
18 TWIS (TWI0)
19 TWIM (TWI0)
20 INT (SPI0)
21 RXC (USART0)
22 DRE (USART0)
23 TXC (USART0)
24 PORT (PORTD)
25 AC (AC0)
26 RESRDY (ADC0)
27 WCMP (ADC0)
28 ZCD (ZCD0)
29 AC (AC1)
30 PORT (PORTC)
31 INT (TCB2)
32 RXC (USART1)
33 DRE (USART1)
34 TXC (USART1)
35 PORT (PORTF)
36 EE (NVMCTRL)
37 INT (SPI1)
38 RXC (USART2)
39 DRE (USART2)
40 TXC (USART2)
41 AC (AC2)
42 TWIS (TWI1)
43 TWIM (TWI1)
44 INT (TCB3)
45 PORT (PORTB)
46 PORT (PORTE)
47 LUNF (TCA1)
47 OVF (TCA1)
48 HUNF (TCA1)
49 CMP0 (TCA1)
49 LCMP0 (TCA1)
50 CMP1 (TCA1)
50 LCMP1 (TCA1)
51 CMP2 (TCA1)
51 LCMP2 (TCA1)
52 ZCD (ZCD1)
53 RXC (USART3)
54 DRE (USART3)
55 TXC (USART3)
56 RXC (USART4)
57 DRE (USART4)
58 TXC (USART4)
60 ZCD (ZCD2)

## Properties
OCD_FEATURES: BREAK_PIN=PF6, BREAK_PIN_ALT=PF2
SIGNATURES: SIGNATURE0=0x1E, SIGNATURE1=0x97, SIGNATURE2=0x0C

## Pinouts (pin number, pad)
QFN48: 1 PA5, 2 PA6, 3 PA7, 4 PB0, 5 PB1, 6 PB2, 7 PB3, 8 PB4, 9 PB5, 10 PC0, 11 PC1, 12 PC2, 13 PC3, 14 VDDIO2, 15 GND0, 16 PC4, 17 PC5, 18 PC6, 19 PC7, 20 PD0, 21 PD1, 22 PD2, 23 PD3, 24 PD4, 25 PD5, 26 PD6, 27 PD7, 28 AVDD, 29 AGND, 30 PE0, 31 PE1, 32 PE2, 33 PE3, 34 PF0, 35 PF1, 36 PF2, 37 PF3, 38 PF4, 39 PF5, 40 PF6, 41 UPDI, 43 GND2, 44 PA0, 45 PA1, 46 PA2, 47 PA3, 48 PA4
